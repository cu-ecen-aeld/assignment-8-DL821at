## base_external/Config.in
```kconfig
source "/home/dleevm/assignment4/base_external/package/aesd-assignments/Config.in"
```

## base_external/package/aesd-assignments/Config.in
```kconfig
config BR2_PACKAGE_AESD_ASSIGNMENTS
	bool "aesd-assignments"
	help
	  Includes aesdsocket, circular buffer driver, and finder-app in Buildroot image.
```

## base_external/package/ldd/Config.in
```kconfig
config BR2_PACKAGE_LDD
	bool "ldd"
	help
      Includes the writer executable, finder.sh, and tester.sh in the kernel image.
      Used to understand Buildroot external trees and package builds.
```
